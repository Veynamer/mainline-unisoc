## Documentation/devicetree/bindings/clock/sprd,ums9230-clk.yaml
```yaml
# SPDX-License-Identifier: (GPL-2.0-only OR BSD-2-Clause)
%YAML 1.2
---
$id: http://devicetree.org/schemas/clock/sprd,ums9230-clk.yaml#
$schema: http://devicetree.org/meta-schemas/core.yaml#

title: UMS9230 SoC clock controller

maintainers:
  - Otto Pflüger <otto.pflueger@abscue.de>

properties:
  compatible:
    enum:
      - sprd,ums9230-aon-gate
      - sprd,ums9230-aonapb-clk
      - sprd,ums9230-ap-clk
      - sprd,ums9230-apahb-gate
      - sprd,ums9230-apapb-gate
      - sprd,ums9230-audcpahb-gate
      - sprd,ums9230-audcpapb-gate
      - sprd,ums9230-g0-pll
      - sprd,ums9230-g1-pll
      - sprd,ums9230-g3-pll
      - sprd,ums9230-gc-pll
      - sprd,ums9230-gpu-clk
      - sprd,ums9230-mm-clk
      - sprd,ums9230-mm-gate-clk
      - sprd,ums9230-pmu-gate

  "#clock-cells":
    const: 1

  power-domains:
    maxItems: 1

  reg:
    maxItems: 1

  "#reset-cells":
    const: 1

allOf:
  - if:
      properties:
        compatible:
          contains:
            const: sprd,ums9230-aonapb-clk
    then:
      properties:
        clocks:
          minItems: 3
          maxItems: 3
        clock-names:
          items:
            - const: ext-26m
            - const: ext-32k
            - const: rco-100m
      required:
        - clocks
        - clock-names

  - if:
      properties:
        compatible:
          contains:
            const: sprd,ums9230-ap-clk
    then:
      properties:
        clocks:
          minItems: 3
          maxItems: 3
        clock-names:
          items:
            - const: ext-26m
            - const: dphy-250m
            - const: dphy-333m3
      required:
        - clocks
        - clock-names

  - if:
      properties:
        compatible:
          contains:
            const: sprd,ums9230-mm-clk
    then:
      properties:
        clocks:
          minItems: 2
          maxItems: 2
        clock-names:
          items:
            - const: ext-26m
            - const: enable
      required:
        - clocks
        - clock-names

  - if:
      properties:
        compatible:
          contains:
            enum:
              - sprd,ums9230-aon-gate
              - sprd,ums9230-apahb-gate
              - sprd,ums9230-apapb-gate
              - sprd,ums9230-audcpahb-gate
              - sprd,ums9230-g1-pll
              - sprd,ums9230-g3-pll
              - sprd,ums9230-gc-pll
              - sprd,ums9230-gpu-clk
              - sprd,ums9230-pmu-gate
    then:
      properties:
        clocks:
          minItems: 1
          maxItems: 1
        clock-names:
          items:
            - const: ext-26m
      required:
        - clocks
        - clock-names

required:
  - compatible
  - '#clock-cells'
  - reg

unevaluatedProperties: false

examples:
  - |
    ap_clk: clock-controller@20010000 {
      compatible = "sprd,ums9230-ap-clk";
      reg = <0x20010000 0x1000>;
      clocks = <&ext_26m>, <&dphy_250m>, <&dphy_333m3>;
      clock-names = "ext-26m", "dphy-250m", "dphy-333m3";
      #clock-cells = <1>;
    };
...
```

## drivers/media/platform/sprd/Kconfig
```kconfig
# SPDX-License-Identifier: GPL-2.0-only

comment "Unisoc media platform drivers"

source "drivers/media/platform/sprd/camsys/Kconfig"
```

## drivers/net/wireless/unisoc/Kconfig
```kconfig
# SPDX-License-Identifier: GPL-2.0-only
config WLAN_VENDOR_UNISOC
	bool "Unisoc devices"
	default y
	help
	  If you have a wireless card belonging to this class, say Y.

	  Note that the answer to this question doesn't directly affect the
	  kernel: saying N will just cause the configurator to skip all the
	  questions about these cards. If you say Y, you will be asked for
	  your specific card in the following questions.

if WLAN_VENDOR_UNISOC

config SC23XX_CORE
	tristate

config SC23XX_SIPC
	tristate "Unisoc UMW26xx/SC23xx series integrated WiFi support"
	depends on CFG80211
	depends on RPMSG
	select SC23XX_CORE
	help
	  This driver implements support for WiFi on Unisoc SoCs with an
	  integrated wireless controller combined with an SC23xx-series
	  chip.

endif
```

## drivers/pmdomain/sprd/Kconfig
```kconfig
# SPDX-License-Identifier: GPL-2.0-only

if ARCH_SPRD || COMPILE_TEST

config SPRD_PM_DOMAINS
	bool "Unisoc PMU power domain support"
	depends on PM
	select PM_GENERIC_DOMAINS

endif
```

## drivers/soc/sprd/Kconfig
```kconfig
# SPDX-License-Identifier: GPL-2.0-only

menu "Spreadtrum and Unisoc SoC drivers"

config SPRD_AGDSP
	tristate "Audio DSP support"
	depends on ARCH_SPRD || COMPILE_TEST
	depends on MAILBOX
	help
	  Say y here to enable support for communication with the audio
	  DSP found in Spreadtrum/Unisoc SoCs.

endmenu
```

## sound/soc/sprd/Kconfig
```kconfig
# SPDX-License-Identifier: GPL-2.0-only
menuconfig SND_SOC_SPRD
	tristate "Spreadtrum"
	depends on ARCH_SPRD || COMPILE_TEST
	help
	  Say Y or M if you want to add support for codecs attached to
	  the Spreadtrum SoCs' Audio interfaces.

if SND_SOC_SPRD

config SND_SOC_SPRD_COMMON
	tristate

config SND_SOC_SPRD_PLATFORM
	tristate
	select SND_SOC_COMPRESS

config SND_SOC_SPRD_MCDT
	tristate "Spreadtrum multi-channel data transfer support"
	depends on SND_SOC_SPRD
	help
	  Say y here to enable multi-channel data transfer support. It
	  is used for sound stream transmission between audio subsystem
	  and other AP/CP subsystem.

config SND_SOC_SPRD_UMS9230
	tristate "SoC Audio support for UMS9230"
	depends on SND_SOC_SPRD
	select SND_SOC_SPRD_COMMON
	select SND_SOC_SPRD_MCDT
	select SND_SOC_SPRD_PLATFORM
	select SND_SOC_SPRD_VBC_V4_DSP
	help
	  Say Y here to enable audio support for typical systems such as
	  mobile phones based on the Unisoc UMS9230 SoCs

config SND_SOC_SPRD_VBC_V4_DSP
	tristate "Unisoc VBC v4 (DSP) support"
	depends on SPRD_AGDSP
	depends on SND_SOC_SPRD_MCDT
	help
	  Say Y here to add support for DSP-based audio in SoCs such as
	  UMS9230.

endif
```
