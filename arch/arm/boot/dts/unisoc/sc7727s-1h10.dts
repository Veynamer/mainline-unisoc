// SPDX-License-Identifier: GPL-2.0
/*
 * Spreadtrum sharkl sp7727s board DTS file
 *
 * Copyright (C) 2025, Vladimir Panferov
 */

/dts-v1/;

#include <sc7727s.dtsi>
#include <sc2723.dtsi>

/ {
	model = "Spreadtrum SP7727S 1h10 Board";
	compatible = "sprd,sp7727s-1h10", "sprd,sc7727s";

	memory {
		device_type = "memory";
		reg = <0x80000000 0x20000000>;
	};

	chosen {
		stdout-path = "serial0:115200n8";
		bootargs = "earlycon init=/init root=/dev/ram0 rw";
};

&uart0 {
	status = "okay";
};

&uart1 {
	status = "okay";
};

&uart2 {
	status = "okay";
};

&uart3 {
	status = "okay";
};
