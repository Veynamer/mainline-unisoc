## arch/arm/mach-unisoc/Kconfig
```kconfig
# SPDX-License-Identifier: GPL-2.0-only

menuconfig ARCH_UNISOC
	bool "Unisoc/Spreadtrum SoC Support"
	depends on ARCH_MULTI_V7
	select ARM_AMBA
	select ARM_GIC
	select VFPv3
	select HAVE_ARM_ARCH_TIMER
	select PINCTRL
	select PINCTRL_SPRD
	select PM_GENERIC_DOMAINS if PM
	select SRAM
	select THERMAL
	select THERMAL_OF
	select MFD_SYSCON
	select MEMORY
	select COMMON_CLK
	select REGMAP
	select IRQ_DOMAIN
	select GENERIC_IRQ_CHIP
	select POWER_RESET
	select POWER_RESET_SYSCON
	select POWER_RESET_SYSCON_POWEROFF
	help
	  Support for Unisoc/Spreadtrum ARMv7 SoCs.
```

## drivers/media/platform/sprd/camsys/Kconfig
```kconfig
# SPDX-License-Identifier: GPL-2.0-only

config VIDEO_SPRD_CAMSYS
	tristate "Unisoc Camera Subsystem driver"
	depends on V4L_PLATFORM_DRIVERS
	depends on VIDEO_DEV
	depends on ARCH_SPRD || COMPILE_TEST
	select MEDIA_CONTROLLER
	select VIDEO_V4L2_SUBDEV_API
	select VIDEOBUF2_DMA_CONTIG
	select VIDEOBUF2_VMALLOC
	select V4L2_FWNODE
```

## drivers/media/platform/sprd/isp/Kconfig
```kconfig
# SPDX-License-Identifier: GPL-2.0-only

config VIDEO_SPRD_ISP
	tristate "Unisoc ISP driver"
	depends on V4L_PLATFORM_DRIVERS
	depends on VIDEO_DEV
	depends on ARCH_SPRD || COMPILE_TEST
	select VIDEO_V4L2_SUBDEV_API
	select MEDIA_CONTROLLER
	select VIDEOBUF2_DMA_CONTIG
	select VIDEOBUF2_VMALLOC
```
